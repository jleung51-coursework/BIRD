/*
 *
 * Author: Jeffrey Leung
 * Last edited: 2016-03-19
 *
 * This Arduino sketch receives communication through Bluetooth relating
 * to whether or not the sensor systems are activated, and alerts the user if
 * a user is present and the sensors return the presence of an item.
 *
 */

#include <avr/pgmspace.h>
#include <PCM.h>
#include <SoftwareSerial.h>

const unsigned int pinCapacitive = A0;

// PCM.h automatically defines 11 as the speaker pin
const unsigned int pinSpeaker = 11;
const unsigned int pinTransistorPower = 10;
const unsigned int pinProximityTrigger = 9;
const unsigned int pinProximityEcho = 8;
const unsigned int pinCapacitivePower = 7;

const unsigned int pinPowerLED = 6;
const unsigned int pinEssentialLED = 5;
const unsigned int pinGeneralLED = 4;

const unsigned int thresholdProximity = 35;
const unsigned int thresholdCapacitive = 500;

SoftwareSerial ppad(2, 3);

// States
bool powerOn = true;
bool powerToggled = false;

const unsigned char alertSound[] PROGMEM = {
  125, 127, 153, 122, 86, 141, 177, 103, 77, 160, 177, 85,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 128,
};

// This method returns whether the proximity sensor reads within
// the proximity threshold.
//
// Configured for the SRF05 Ultrasonic Sensor:
// http://www.robot-electronics.co.uk/htm/srf05tech.htm
bool ProximityActivated() {
  digitalWrite(pinProximityTrigger, LOW);
  delay(2);
  digitalWrite(pinProximityTrigger, HIGH);
  delay(10);
  digitalWrite(pinProximityTrigger, LOW);

  unsigned long distance = pulseIn(pinProximityEcho, HIGH);
  // Divided by 2 because the sound travels twice the distance
  // Divided by 29 because the speed of sound is
  //   343m/sec = 0.0343cm/μs = [1/29.1] cm/μs
  distance = distance / 2 / 29;
  return distance < thresholdProximity;
}

void setup() {
  Serial.begin(9600);
  ppad.begin(9600);

  pinMode(pinCapacitive, INPUT);

  pinMode(pinProximityTrigger, OUTPUT);
  pinMode(pinProximityEcho, INPUT);

  pinMode(pinTransistorPower, OUTPUT);
  pinMode(pinCapacitivePower, OUTPUT);

  pinMode(pinPowerLED, OUTPUT);
  pinMode(pinEssentialLED, OUTPUT);
  pinMode(pinGeneralLED, OUTPUT);

  digitalWrite(pinProximityTrigger, LOW);

  digitalWrite(pinTransistorPower, HIGH);
  digitalWrite(pinCapacitivePower, HIGH);

  digitalWrite(pinPowerLED, HIGH);
}


void loop() {
  ppad.flush();
  delay(100);

  bool alertSensorEssential = false;
  bool alertSensorGeneral = false;

  digitalWrite(pinEssentialLED, LOW);
  digitalWrite(pinGeneralLED, LOW);

  // Power on/off
  if(!powerOn) {
    digitalWrite(pinPowerLED, LOW);
    delay(3 * 1000);  // 3 seconds in addition to the 3 second delay
    powerOn = true;
  }
  else {
    digitalWrite(pinPowerLED, HIGH);

    if(ppad.available()) {
      String in = ppad.readStringUntil('\n');
      Serial.println(in);
      //Serial.print("Char1:");
      //Serial.println(c1);
      //Serial.print("Char2:");
      //Serial.println(c2);
      //Serial.flush();
      //while(Serial.available() && Serial.read() != '\n');  // Newline clear

      if(in.charAt(0) == '1') {
        alertSensorEssential = true;
      }
      if(in.charAt(1) == '1') {
        alertSensorGeneral = true;
      }
    }
  }

  while(powerOn &&
        ProximityActivated() &&
        (alertSensorEssential || alertSensorGeneral)) {

    startPlayback(alertSound, sizeof(alertSound)); // PCM.h

    digitalWrite(pinEssentialLED, LOW);
    digitalWrite(pinGeneralLED, LOW);
    if(alertSensorEssential) {
      digitalWrite(pinEssentialLED, HIGH);

    }
    if(alertSensorGeneral) {
      digitalWrite(pinGeneralLED, HIGH);
    }

    if(analogRead(pinCapacitive) < thresholdCapacitive) {
      powerOn = false;
      digitalWrite(pinPowerLED, LOW);
      digitalWrite(pinEssentialLED, LOW);
      digitalWrite(pinGeneralLED, LOW);
    }

    Serial.println("ALERT");

    delay(.2 * 1000);
  }
}
